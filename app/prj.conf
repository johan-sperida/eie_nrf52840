## CMakeLists.txt
```
#-------------------------------------------------------------------------------
# Zephyr Example Application
#
# Copyright (c) 2021 Nordic Semiconductor ASA
# SPDX-License-Identifier: Apache-2.0

cmake_minimum_required(VERSION 3.13.1)
find_package(Zephyr REQUIRED HINTS $ENV{ZEPHYR_BASE})

project(app LANGUAGES C)

zephyr_include_directories(src)

target_sources(app PRIVATE src/main.c)
target_sources(app PRIVATE src/ble_manager.c)
target_sources(app PRIVATE src/MyStateMachine/my_state_machine.c)

target_sources(app PRIVATE src/MyStateMachine/sceneObjects/transitionScreens.c)
target_sources(app PRIVATE src/MyStateMachine/sceneObjects/menuState.c)
target_sources(app PRIVATE src/MyStateMachine/sceneObjects/transitionState.c)
target_sources(app PRIVATE src/MyStateMachine/sceneObjects/minigameState.c)
target_sources(app PRIVATE src/MyStateMachine/sceneObjects/lossState.c)
```

## prj.conf
```kconfig
# Copyright (c) 2021 Nordic Semiconductor ASA
# SPDX-License-Identifier: Apache-2.0
#
# This file contains selected Kconfig options for the application.

CONFIG_GPIO=y
CONFIG_PWM=y
CONFIG_SMF=y

CONFIG_DISPLAY=y
CONFIG_LVGL=y

CONFIG_LV_Z_MEM_POOL_SIZE=16384
CONFIG_MAIN_STACK_SIZE=4096

CONFIG_BT=y
CONFIG_BT_CENTRAL=y
CONFIG_BT_GATT_CLIENT=y
CONFIG_BT_HCI_ERR_TO_STR=y
CONFIG_BT_USER_DATA_LEN_UPDATE=y
CONFIG_CBPRINTF_FP_SUPPORT=y
```

## src/main.c
```c
/*
 * main.c
 */

/* IMPORTS
 * --------------------------------------------------------------------------------------
 */

#include <errno.h>
#include <zephyr/device.h>
#include <zephyr/drivers/display.h>
#include <zephyr/kernel.h>
#include <zephyr/sys/printk.h>

#include "BTN.h"
#include "LED.h"
#include "MyStateMachine/my_state_machine.h"
#include "ble_manager.h"

/* MACROS
 * ---------------------------------------------------------------------------------------
 */

#define SLEEP_MS 1

/* VARIABLES
 * -----------------------------------------------------------------------------------
 */

static const struct device *display_dev;

/* MAIN
 * -----------------------------------------------------------------------------------------
 */

int main(void) {
  display_dev = DEVICE_DT_GET(DT_CHOSEN(zephyr_display));

  if (!device_is_ready(display_dev)) {
    return -1;
  }

  display_blanking_off(display_dev);

  if (0 > BTN_init()) {
    return 0;
  }
  if (0 > LED_init()) {
    return 0;
  }

  int err = ble_init();
  if (err) {
    return 0;
  }

  while (1) {
    state_machine_init();

    // Load the first screen
    lv_timer_handler();

    // commenting this out until functional BLE game is in place

    // ble_start_scanning();

    // while(!ble_is_connected()){
    //   printk("Searching\n");
    //   k_msleep(SLEEP_MS * 5);
    // }

    int ret;
    while (1) { // ble_is_connected()
      // must call periodically to render changes
      ret = state_machine_run();
      k_msleep(SLEEP_MS);
    }

    // To disconnect: bt_conn_disconnect(conn,
    // BT_HCI_ERR_REMOTE_USER_TERM_CONN);
  }
  return 0;
}
```

## src/GattAttributeDump.c
```c
/*
 * main.c
 */

/* IMPORTS -------------------------------------------------------------------------------------- */

#include <errno.h>
#include <inttypes.h>
#include <stddef.h>
#include <zephyr/bluetooth/bluetooth.h>
#include <zephyr/bluetooth/conn.h>
#include <zephyr/bluetooth/gatt.h>
#include <zephyr/bluetooth/hci.h>
#include <zephyr/bluetooth/uuid.h>
#include <zephyr/kernel.h>
#include <zephyr/sys/byteorder.h>
#include <zephyr/sys/printk.h>
#include <zephyr/types.h>

#include "BTN.h"
#include "LED.h"

/* MACROS --------------------------------------------------------------------------------------- */

#define SLEEP_MS 1

// #define BLE_CUSTOM_SERVICE_UUID \
//   BT_UUID_128_ENCODE(0x11111111, 0x1111, 0x1111, 0x1111, 0x111111111111)
// #define BLE_CUSTOM_CHARACTERISTIC_UUID \
//   BT_UUID_128_ENCODE(0x11111111, 0x1111, 0x1111, 0x1111, 0x111111111112)

// #define SERVICE BT_UUID_DECLARE_128(BLE_CUSTOM_SERVICE_UUID)
// #define CHARACTERISTIC BT_UUID_DECLARE_128(BLE_CUSTOM_CHARACTERISTIC_UUID)

static struct bt_uuid_128 BLE_CUSTOM_SERVICE_UUID =
    BT_UUID_INIT_128(BT_UUID_128_ENCODE(0x11111111, 0x1111, 0x1111, 0x1111, 0x111111111111));
static struct bt_uuid_128 BLE_CUSTOM_CHARACTERISTIC_UUID =
    BT_UUID_INIT_128(BT_UUID_128_ENCODE(0x11111112, 0x1111, 0x1111, 0x1111, 0x111111111111));

/* PROTOTYPES ----------------------------------------------------------------------------------- */

static void ble_start_scanning(void);
static uint8_t discover_func(struct bt_conn* conn, const struct bt_gatt_attr* attr,
                             struct bt_gatt_discover_params* params);
static uint8_t notify_func(struct bt_conn* conn, struct bt_gatt_subscribe_params* params,
                           const void* data, uint16_t length);

/* VARIABLES  ----------------------------------------------------------------------------------- */

static struct bt_conn* my_connection;
static struct bt_uuid_16 discover_uuid = BT_UUID_INIT_16(0);
static struct bt_gatt_discover_params discover_params;
static struct bt_gatt_subscribe_params subscribe_params;

/* FUNCTIONS ------------------------------------------------------------------------------------ */

static bool ble_get_adv_device_name_cb(struct bt_data* data, void* user_data) {
  char* name = user_data;

  if (data->type == BT_DATA_NAME_COMPLETE || data->type == BT_DATA_NAME_SHORTENED) {
    /* Copy the name to the user data buffer */
    memcpy(name, data->data, data->data_len);
    name[data->data_len] = '\0'; /* Null-terminate the string */
    return false;                 /* Stop parsing after finding the name */
  }

  return true; /* Continue parsing */
}

static void ble_on_advertisement_received(const bt_addr_le_t* addr, int8_t rssi, uint8_t type,
                                          struct net_buf_simple* ad) {
  char addr_str[BT_ADDR_LE_STR_LEN];
  int err;

  if (my_connection) {
    return;
  }

  /* We're only interested in connectable events */
  if (type != BT_GAP_ADV_TYPE_ADV_IND && type != BT_GAP_ADV_TYPE_ADV_DIRECT_IND) {
    return;
  }

  char name[32] = {0};
  bt_data_parse(ad, ble_get_adv_device_name_cb, name);
  bt_addr_le_to_str(addr, addr_str, sizeof(addr_str));
  printk("Device found: %s (RSSI %d) - '%s'\n", addr_str, rssi, name);

  /* connect only to devices in close proximity */
  if (rssi < -40) {
    return;
  }

  if (bt_le_scan_stop()) {
    return;
  }

  err = bt_conn_le_create(addr, BT_CONN_LE_CREATE_CONN, BT_LE_CONN_PARAM_DEFAULT, &my_connection);
  if (err) {
    printk("Create conn to %s failed (%d)\n", addr_str, err);
    ble_start_scanning();
  }

  //On success, goes to ble_on_device_connected

}

static void ble_start_scanning(void) {
  int err;

  /* This demo doesn't require active scan */
  err = bt_le_scan_start(BT_LE_SCAN_PASSIVE, ble_on_advertisement_received);
  if (err) {
    printk("Scanning failed to start (err %d)\n", err);
    return;
  }

  printk("Scanning successfully started\n");
}

static void ble_on_device_connected(struct bt_conn* conn, uint8_t err) {
  char addr[BT_ADDR_LE_STR_LEN];

  bt_addr_le_to_str(bt_conn_get_dst(conn), addr, sizeof(addr));

  if (err) {
    printk("Failed to connect to %s %u %s\n", addr, err, bt_hci_err_to_str(err));

    bt_conn_unref(my_connection);
    my_connection = NULL;

    ble_start_scanning();
    return;
  }

  if (conn != my_connection) {
    return;
  }

  printk("Connected: %s\n", addr);

  discover_params.uuid = NULL; // Switched from &BLE_CUSTOM_SERVICE_UUID.uuid
  discover_params.func = discover_func;
  discover_params.start_handle = BT_ATT_FIRST_ATTRIBUTE_HANDLE;
  discover_params.end_handle = BT_ATT_LAST_ATTRIBUTE_HANDLE;
  discover_params.type = BT_GATT_DISCOVER_ATTRIBUTE; //Switched from BT_GATT_DISCOVER_PRIMARY

  err = bt_gatt_discover(my_connection, &discover_params);
  if (err) {
    printk("Discover failed(err %d)\n", err);
    return;
  }

  //on success, goes to discover func
}

static void ble_on_device_disconnected(struct bt_conn* conn, uint8_t reason) {
  char addr[BT_ADDR_LE_STR_LEN];

  if (conn != my_connection) {
    return;
  }

  bt_addr_le_to_str(bt_conn_get_dst(conn), addr, sizeof(addr));

  printk("Disconnected: %s, reason 0x%02x %s\n", addr, reason, bt_hci_err_to_str(reason));

  bt_conn_unref(my_connection);
  my_connection = NULL;

  ble_start_scanning();
}

static uint8_t discover_func1(struct bt_conn* conn, const struct bt_gatt_attr* attr,
                             struct bt_gatt_discover_params* params) {
  int err;

  if (!attr) {
    printk("Discover complete\n");
    (void)memset(params, 0, sizeof(*params));
    return BT_GATT_ITER_STOP;
  }

  // attr->user_data contains the bt_gatt_service_val which holds the UUID
  char uuid_str[BT_UUID_STR_LEN];
  struct bt_gatt_service_val *gatt_service = attr->user_data;
  
  bt_uuid_to_str(gatt_service->uuid, uuid_str, sizeof(uuid_str));

  printk("Found Service: %s (Handle: %u)\n", uuid_str, attr->handle);




  printk("[ATTRIBUTE] handle %u\n", attr->handle);

  if (!bt_uuid_cmp(discover_params.uuid, &BLE_CUSTOM_SERVICE_UUID.uuid)) {
    discover_params.uuid = &BLE_CUSTOM_CHARACTERISTIC_UUID.uuid;
    discover_params.start_handle = attr->handle + 1;
    discover_params.type = BT_GATT_DISCOVER_CHARACTERISTIC;

    err = bt_gatt_discover(conn, &discover_params);
    if (err) {
      printk("Discover failed (err %d)\n", err);
    }
  } else if (!bt_uuid_cmp(discover_params.uuid, &BLE_CUSTOM_CHARACTERISTIC_UUID.uuid)) {
    memcpy(&discover_uuid, BT_UUID_GATT_CCC, sizeof(discover_uuid));
    discover_params.uuid = &discover_uuid.uuid;
    discover_params.start_handle = attr->handle + 2;
    discover_params.type = BT_GATT_DISCOVER_DESCRIPTOR;
    subscribe_params.value_handle = bt_gatt_attr_value_handle(attr);

    err = bt_gatt_discover(conn, &discover_params);
    if (err) {
      printk("Discover failed (err %d)\n", err);
    }
  } else {
    subscribe_params.notify = notify_func;
    subscribe_params.value = BT_GATT_CCC_NOTIFY;
    subscribe_params.ccc_handle = attr->handle;

    err = bt_gatt_subscribe(conn, &subscribe_params);
    if (err && err != -EALREADY) {
      printk("Subscribe failed (err %d)\n", err);
    } else {
      printk("[SUBSCRIBED]\n");
    }

    return BT_GATT_ITER_STOP;
  }

  return BT_GATT_ITER_CONTINUE;  //Was replaced from BT_GATT_ITER_STOP
}

static uint8_t discover_func(struct bt_conn *conn,
                             const struct bt_gatt_attr *attr,
                             struct bt_gatt_discover_params *params)
{
    if (!attr) {
        printk("--- End of GATT Table ---\n");
        return BT_GATT_ITER_STOP;
    }

    char type_uuid[BT_UUID_STR_LEN];
    char value_uuid[BT_UUID_STR_LEN] = "N/A";

    // Convert the Attribute Type UUID to string (e.g., 2800, 2803, 2902)
    bt_uuid_to_str(attr->uuid, type_uuid, sizeof(type_uuid));

    // If it's a Service (0x2800) or Characteristic (0x2803), the "Value" is a UUID
    if (!bt_uuid_cmp(attr->uuid, BT_UUID_GATT_PRIMARY) ||
        !bt_uuid_cmp(attr->uuid, BT_UUID_GATT_SECONDARY)) {
        struct bt_gatt_service_val *val = attr->user_data;
        bt_uuid_to_str(val->uuid, value_uuid, sizeof(value_uuid));
    } else if (!bt_uuid_cmp(attr->uuid, BT_UUID_GATT_CHRC)) {
        struct bt_gatt_chrc *val = attr->user_data;
        bt_uuid_to_str(val->uuid, value_uuid, sizeof(value_uuid));
    }

    printk("[Handle %u] Type: %s | Value: %s\n", 
           attr->handle, type_uuid, value_uuid);

    return BT_GATT_ITER_CONTINUE;
}

static uint8_t notify_func(struct bt_conn* conn, struct bt_gatt_subscribe_params* params,
                           const void* data, uint16_t length) {
  if (!data) {
    printk("[UNSUBSCRIBED]\n");
    params->value_handle = 0U;
    return BT_GATT_ITER_STOP;
  }

  printk("[NOTIFICATION] data %p length %u\n", data, length);
  for (int i = 0; i < MIN(length, 16); i++) {
    printk(" 0x%02X", ((uint8_t*)data)[i]);
  }
  printk("\n");

  return BT_GATT_ITER_CONTINUE;
}

/* CALLBACK CONFIG ------------------------------------------------------------------------------ */

BT_CONN_CB_DEFINE(conn_callbacks) = {
    .connected = ble_on_device_connected,
    .disconnected = ble_on_device_disconnected,
};

/* MAIN ----------------------------------------------------------------------------------------- */

int main(void) {
  if (0 > BTN_init()) {
    return 0;
  }
  if (0 > LED_init()) {
    return 0;
  }

  int err = bt_enable(NULL);
  if (err) {
    printk("Bluetooth init failed (err %d)\n", err);
    return 0;
  } else {
    printk("Bluetooth initialized\n");
  }

  ble_start_scanning();

  while (1) {
    k_msleep(SLEEP_MS);
  }

  // To disconnect: bt_conn_disconnect(conn, BT_HCI_ERR_REMOTE_USER_TERM_CONN);

  return 0;
}
```

## src/Johann.c
```c
/*
 * main.c
 */

#include <stdio.h>
#include <string.h>
#include <zephyr/bluetooth/bluetooth.h>
#include <zephyr/bluetooth/conn.h>
#include <zephyr/bluetooth/gatt.h>
#include <zephyr/bluetooth/hci.h>
#include <zephyr/bluetooth/uuid.h>
#include <zephyr/device.h>
#include <zephyr/devicetree.h>
#include <zephyr/drivers/display.h>
#include <zephyr/drivers/gpio.h>
#include <zephyr/kernel.h>
#include <zephyr/settings/settings.h>
#include <zephyr/sys/printk.h>
#include <inttypes.h>

#define BLE_CUSTOM_SERVICE_UUID BT_UUID_128_ENCODE(0x12345678, 0x1234, 0x5678, 0x1234, 0x56789abcdef0)
#define BLE_CUSTOM_CHARACTERISTIC_UUID BT_UUID_128_ENCODE(0x12345678, 0x1234, 0x5678, 0x1234, 0x56789abcdef0)

#define BLE_CUSTOM_CHARACTERISTIC_MAX_DATA_LENGTH 20

static const struct bt_data ble_advertising_data[] = {
  BT_DATA_BYTES(BT_DATA_FLAGS, BT_LE_AD_GENERAL, BT_LE_AD_NO_BREDR),
  BT_DATA(BT_DATA_NAME_COMPLETE, CONFIG_BT_DEVICE_NAME, sizeof(CONFIG_BT_DEVICE_NAME)),
};

static uint8_t ble_custom_characteristic_user_data[20] = {};

static ssize_t ble_custom_characteristic_read_cb(struct bt_conn* conn, const struct bt_gatt_attr* attr,
                                                 void* buf, uint16_t len, uint16_t offset) {
  const char* value = attr->user_data;
  return bt_gatt_attr_read(conn, attr, buf, len, offset, value, strlen(value));
}

static ssize_t ble_custom_characteristic_write_cb(struct bt_conn* conn, const struct bt_gatt_attr* attr,
                                                  const void* buf, uint16_t len, uint16_t offset,
                                                  uint8_t flags) {
  uint8_t* value_ptr = attr->user_data;

  if (offset + len > BLE_CUSTOM_CHARACTERISTIC_MAX_DATA_LENGTH) {
    return BT_GATT_ERR(BT_ATT_ERR_INVALID_OFFSET);
  }

  memcpy(value_ptr + offset, buf, len);
  value_ptr[offset + len] = 0;

  return len;
}

static const struct bt_uuid_128 ble_custom_service_uuid = BT_UUID_INIT_128(BLE_CUSTOM_SERVICE_UUID);
static const struct bt_uuid_128 ble_custom_characteristic_uuid = BT_UUID_INIT_128(BLE_CUSTOM_CHARACTERISTIC_UUID);

BT_GATT_SERVICE_DEFINE(
    ble_custom_service,  // Name of the struct that will store the config for this service
    BT_GATT_PRIMARY_SERVICE(&ble_custom_service_uuid),  // Setting the service UUID
    BT_GATT_CHARACTERISTIC(
        &ble_custom_characteristic_uuid.uuid,  // Setting the characteristic UUID
        BT_GATT_CHRC_READ | BT_GATT_CHRC_WRITE,  // Possible operations
        BT_GATT_PERM_READ | BT_GATT_PERM_WRITE,  // Permissions that connecting devices have
        ble_custom_characteristic_read_cb,     // Callback for when this characteristic is read from
        ble_custom_characteristic_write_cb,    // Callback for when this characteristic is written to
        ble_custom_characteristic_user_data    // Initial data stored in this characteristic
        )
);



int main(void) 
{
  int err_code = bt_enable(NULL);
  if (err_code != 0)
  {
    printk("Error code %d\n", err_code);
    return 0;
  }

  err_code = bt_le_adv_start(BT_LE_ADV_CONN_FAST_1,
     ble_advertising_data, 
     ARRAY_SIZE(ble_advertising_data),
    NULL,
    0);

  if (err_code != 0)
  {
    printk("Error code %d\n", err_code);
    return 0;
  }


	return 0;
}
```

## src/SceneMain.c
```c
/**
 * @file main.c
 */

#include <inttypes.h>

#include <zephyr/kernel.h>
#include <zephyr/sys/printk.h>
#include <zephyr/drivers/display.h>
#include <zephyr/device.h>


#include <lvgl.h>

#include "BTN.h"
#include "LED.h"
#include "lv_data_obj.h"
#include "scenes.h"
#include "MyStateMachine/my_state_machine.h"

#define SLEEP_MS 1

static const struct device *display_dev;


int main(void) {
  display_dev = DEVICE_DT_GET(DT_CHOSEN(zephyr_display));
  

  if (!device_is_ready(display_dev)) {
      return -1;
  }

  display_blanking_off(display_dev);  

  if (0 > BTN_init()) {
    return 0;
  }
  if (0 > LED_init()) {
    return 0;
  }

  
  
  state_machine_init();

  char c = 0;
  int ret;
  while (1) {
    //must call periodically to render changes
    ret = state_machine_run();
    k_msleep(SLEEP_MS);
    // scene1.runFunc(&scene1, &c);
    // scene2.runFunc(&scene2, &c);

 

  }
  return 0;
}
```

## src/ble_manager.c
```c
#include "ble_manager.h"

#include <errno.h>
#include <string.h>

#include <zephyr/bluetooth/bluetooth.h>
#include <zephyr/bluetooth/conn.h>
#include <zephyr/bluetooth/gatt.h>
#include <zephyr/bluetooth/hci.h>
#include <zephyr/bluetooth/uuid.h>
#include <zephyr/sys/printk.h>

static const bt_addr_t TARGET_ADDR = {
    .val = {0x19, 0xC0, 0x9C, 0xDD, 0x3A, 0xD8}};

static const bt_addr_le_t TARGET_ADDR_LE = {.type = 1, .a = TARGET_ADDR};

// /* Controls Service: 7859530f-0184-4854-9ffd-69504534e434 */
// static struct bt_uuid_128 CONTROLS_SERVICE_UUID =
//     BT_UUID_INIT_128(BT_UUID_128_ENCODE(0x7859530f, 0x0184, 0x4854, 0x9ffd,
//     0x69504534e434));

// /* Lights Characteristic: 93e249c3-540c-47cf-b85a-61e27b9e2bfd */
// static struct bt_uuid_128 LIGHTS_CHAR_UUID =
//     BT_UUID_INIT_128(BT_UUID_128_ENCODE(0x93e249c3, 0x540c, 0x47cf, 0xb85a,
//     0x61e27b9e2bfd));

// /* Acceleration Characteristic: eea5d803-0013-4eb5-a50f-037642b17c93 */
// static struct bt_uuid_128 ACCELERATION_CHAR_UUID =
//     BT_UUID_INIT_128(BT_UUID_128_ENCODE(0xeea5d803, 0x0013, 0x4eb5, 0xa50f,
//     0x037642b17c93));

static struct bt_uuid_16 DISTANCE_SENSE_SERVICE_UUID = BT_UUID_INIT_16(0x180A);

static struct bt_uuid_128 DISTANCE_CHAR_UUID = BT_UUID_INIT_128(
    BT_UUID_128_ENCODE(0x044e6f5f, 0x4a31, 0x417a, 0x86d5, 0x886292a9ebb5));

static struct bt_conn *my_connection;
static struct bt_uuid_16 discover_uuid = BT_UUID_INIT_16(0);
static struct bt_gatt_discover_params discover_params;
static struct bt_gatt_subscribe_params subscribe_params;

static uint8_t discover_func(struct bt_conn *conn,
                             const struct bt_gatt_attr *attr,
                             struct bt_gatt_discover_params *params);
static uint8_t notify_func(struct bt_conn *conn,
                           struct bt_gatt_subscribe_params *params,
                           const void *data, uint16_t length);

static bool ble_get_adv_device_name_cb(struct bt_data *data, void *user_data) {
  char *name = user_data;

  if (data->type == BT_DATA_NAME_COMPLETE ||
      data->type == BT_DATA_NAME_SHORTENED) {
    memcpy(name, data->data, data->data_len);
    name[data->data_len] = '\0';
    return false;
  }

  return true;
}

static void ble_on_advertisement_received(const bt_addr_le_t *addr, int8_t rssi,
                                          uint8_t type,
                                          struct net_buf_simple *ad) {
  char addr_str[BT_ADDR_LE_STR_LEN];
  int err;

  if (my_connection) {
    return;
  }

  if (type != BT_GAP_ADV_TYPE_ADV_IND &&
      type != BT_GAP_ADV_TYPE_ADV_DIRECT_IND) {
    return;
  }

  char name[32] = {0};
  bt_data_parse(ad, ble_get_adv_device_name_cb, name);
  bt_addr_le_to_str(addr, addr_str, sizeof(addr_str));
  printk("Device found: %s (RSSI %d) - '%s'\n", addr_str, rssi, name);

  if (rssi < -40) {
    return;
  }
  printk("Passed rssi\n");

  if (memcmp(addr->a.val, TARGET_ADDR_LE.a.val, 6) != 0) {
    printk("failed compare\n");
    return;
  }
  printk("Passed compare\n");

  if (bt_le_scan_stop()) {
    return;
  }
  printk("Passed stop scan\n");

  err = bt_conn_le_create(addr, BT_CONN_LE_CREATE_CONN,
                          BT_LE_CONN_PARAM_DEFAULT, &my_connection);
  if (err) {
    printk("Create conn to %s failed (%d)\n", addr_str, err);
    ble_start_scanning();
  }
}

void ble_start_scanning(void) {
  int err;

  err = bt_le_scan_start(BT_LE_SCAN_PASSIVE, ble_on_advertisement_received);
  if (err) {
    printk("Scanning failed to start (err %d)\n", err);
    return;
  }

  printk("Scanning successfully started\n");
}

static void ble_on_device_connected(struct bt_conn *conn, uint8_t err) {
  char addr[BT_ADDR_LE_STR_LEN];

  bt_addr_le_to_str(bt_conn_get_dst(conn), addr, sizeof(addr));

  if (err) {
    printk("Failed to connect to %s %u %s\n", addr, err,
           bt_hci_err_to_str(err));

    bt_conn_unref(my_connection);
    my_connection = NULL;

    ble_start_scanning();
    return;
  }

  if (conn != my_connection) {
    return;
  }

  printk("Connected: %s\n", addr);

  discover_params.uuid = &DISTANCE_SENSE_SERVICE_UUID.uuid;
  discover_params.func = discover_func;
  discover_params.start_handle = BT_ATT_FIRST_ATTRIBUTE_HANDLE;
  discover_params.end_handle = BT_ATT_LAST_ATTRIBUTE_HANDLE;
  discover_params.type = BT_GATT_DISCOVER_PRIMARY;

  err = bt_gatt_discover(my_connection, &discover_params);
  if (err) {
    printk("Discover failed(err %d)\n", err);
    return;
  }
}

static void ble_on_device_disconnected(struct bt_conn *conn, uint8_t reason) {
  char addr[BT_ADDR_LE_STR_LEN];

  if (conn != my_connection) {
    return;
  }

  bt_addr_le_to_str(bt_conn_get_dst(conn), addr, sizeof(addr));
  printk("Disconnected: %s, reason 0x%02x %s\n", addr, reason,
         bt_hci_err_to_str(reason));

  bt_conn_unref(my_connection);
  my_connection = NULL;

  ble_start_scanning();
}

static uint8_t discover_func(struct bt_conn *conn,
                             const struct bt_gatt_attr *attr,
                             struct bt_gatt_discover_params *params) {
  int err;

  if (!attr) {
    printk("Discover complete\n");
    (void)memset(params, 0, sizeof(*params));
    return BT_GATT_ITER_STOP;
  }

  printk("[ATTRIBUTE] handle %u\n", attr->handle);

  if (!bt_uuid_cmp(discover_params.uuid, &DISTANCE_SENSE_SERVICE_UUID.uuid)) {
    discover_params.uuid = &DISTANCE_CHAR_UUID.uuid;
    discover_params.start_handle = attr->handle + 1;
    discover_params.type = BT_GATT_DISCOVER_CHARACTERISTIC;

    err = bt_gatt_discover(conn, &discover_params);
    if (err) {
      printk("Discover failed (err %d)\n", err);
    }
  } else if (!bt_uuid_cmp(discover_params.uuid, &DISTANCE_CHAR_UUID.uuid)) {
    memcpy(&discover_uuid, BT_UUID_GATT_CCC, sizeof(discover_uuid));
    discover_params.uuid = &discover_uuid.uuid;
    discover_params.start_handle = attr->handle + 2;
    discover_params.type = BT_GATT_DISCOVER_DESCRIPTOR;
    subscribe_params.value_handle = bt_gatt_attr_value_handle(attr);

    err = bt_gatt_discover(conn, &discover_params);
    if (err) {
      printk("Discover failed (err %d)\n", err);
    }
  } else {
    subscribe_params.notify = notify_func;
    subscribe_params.value = BT_GATT_CCC_NOTIFY;
    subscribe_params.ccc_handle = attr->handle;

    err = bt_gatt_subscribe(conn, &subscribe_params);
    if (err && err != -EALREADY) {
      printk("Subscribe failed (err %d)\n", err);
    } else {
      printk("[SUBSCRIBED]\n");
    }

    return BT_GATT_ITER_STOP;
  }

  return BT_GATT_ITER_STOP;
}

static uint8_t notify_func(struct bt_conn *conn,
                           struct bt_gatt_subscribe_params *params,
                           const void *data, uint16_t length) {
  if (!data) {
    printk("[UNSUBSCRIBED]\n");
    params->value_handle = 0U;
    return BT_GATT_ITER_STOP;
  }

  return BT_GATT_ITER_CONTINUE;
}

int ble_init(void) {
  int err = bt_enable(NULL);
  if (err) {
    printk("Bluetooth init failed (err %d)\n", err);
    return err;
  }

  printk("Bluetooth initialized\n");
  return 0;
}

bool ble_is_connected(void) { return my_connection != NULL; }

BT_CONN_CB_DEFINE(conn_callbacks) = {
    .connected = ble_on_device_connected,
    .disconnected = ble_on_device_disconnected,
};
```

## src/ble_manager.h
```c
#ifndef BLE_MANAGER_H
#define BLE_MANAGER_H

#include <stdbool.h>

int ble_init(void);
void ble_start_scanning(void);
bool ble_is_connected(void);

#endif
```

## src/main1.c
```c
/*
 * main.c1
 */


#include <zephyr/kernel.h>
#include <zephyr/device.h>
#include <zephyr/drivers/gpio.h>
#include <zephyr/sys/printk.h>
#include <inttypes.h>

#define SLEEP_TIME_MS 1000

#define SW0_NODE DT_ALIAS(sw0)

//struct pointer for the device that triggered, bundles relevant callback data, pin that caused
void button_isr(const struct device *dev, struct gpio_callback *cb, uint32_t pins) {
    printk("Button 0 pressed! Banana\n");
}
//make a struct instance button
static const struct gpio_dt_spec button = GPIO_DT_SPEC_GET(SW0_NODE, gpios);

static struct gpio_callback button_isr_data;

int main(void) {
    int ret;


    //check if ready
    if (!gpio_is_ready_dt(&button)){
        return 0;
    }

    //configure
    ret = gpio_pin_configure_dt(&button, GPIO_INPUT);
    //note the Yoda case prevents (yoda == 5)
    //from being (yoda = 5)
    if (0 > ret) {
        return 0;
    }

    //configure for interrupt
    ret = gpio_pin_interrupt_configure_dt(&button, GPIO_INT_EDGE_TO_ACTIVE);
    if (0 > ret) {
    return 0;
    }

    gpio_init_callback(&button_isr_data, button_isr, BIT(button.pin));
    gpio_add_callback(button.port, &button_isr_data);



    while(1) {
        
        //monkey method (always check)
        // ret = gpio_pin_get_dt(&button);
        // if (0 < ret) {
        //     printk("Bonanza!\n");
        // }
        // k_msleep(SLEEP_TIME_MS);
    }

    return 0;
}
```

## src/my_state_machine.c
```c
/**
 * @file my_state_machine.c
 * 
 */

 #include <zephyr/smf.h>

 #include "LED.h"
 #include "my_state_machine.h"

//function prototypes
static void led_on_state_entry(void* o);
static enum smf_state_result led_on_state_run(void* o);
static void led_off_state_entry(void* o);
static enum smf_state_result led_off_state_run(void* o);

//Typedefs
enum led_state_machine_states {
    LED_ON_STATE,
    LED_OFF_STATE
};

//"typedef" makes it so that you don't have to write "sturct" next to the name each time when intiializing
typedef struct {
    //context variable for machines state
    struct smf_ctx ctx;

    uint16_t count;
} led_state_object_t;

//Local vars
//seems to define what each state is
static const struct smf_state led_states[]= {
    [LED_ON_STATE] = SMF_CREATE_STATE(led_on_state_entry, led_on_state_run, NULL, NULL, NULL),
    [LED_OFF_STATE] = SMF_CREATE_STATE(led_off_state_entry, led_off_state_run, NULL, NULL, NULL)
};

//a struct to keep track of state?
static led_state_object_t led_state_object;

//runs on intialization?
void state_machine_init(){
    led_state_object.count = 0;
    //set some initial state with the state object
    smf_set_initial(SMF_CTX(&led_state_object), &led_states[LED_ON_STATE]);
}


int state_machine_run(){
    //poll the state from the object
    return smf_run_state(SMF_CTX(&led_state_object));
}

static void led_on_state_entry(void* o) {
    LED_set(LED0, LED_ON);
}

static enum smf_state_result led_on_state_run(void* o) {
    if (led_state_object.count > 500) {
        led_state_object.count = 0;
        smf_set_state(SMF_CTX(&led_state_object), &led_states[LED_OFF_STATE]);
    } else {
        led_state_object.count++;
    }
    return SMF_EVENT_HANDLED;
}

static void led_off_state_entry(void* o) {
    LED_set(LED0, LED_OFF);
}

static enum smf_state_result led_off_state_run(void* o) {
    if (led_state_object.count > 500) {
        led_state_object.count = 0;
        smf_set_state(SMF_CTX(&led_state_object), &led_states[LED_ON_STATE]);
    } else {
        led_state_object.count++;
    }
    return SMF_EVENT_HANDLED;
}
```

## src/my_state_machine.h
```c
/** 
 * @file  my_state_machine.h
 * */ 

#ifndef MY_STATE_MACHINE_H
#define MY_STATE_MACHINE_H

void state_machine_init();

int state_machine_run();
#endif // MY STATE MACHINE H
```

## src/successfulButtons!.c
```c
/**
 * @file main.c
 */

#include <inttypes.h>

#include <zephyr/kernel.h>
#include <zephyr/sys/printk.h>
#include <zephyr/drivers/display.h>
#include <zephyr/device.h>


#include <lvgl.h>

#include "BTN.h"
#include "LED.h"
#include "lv_data_obj.h"

#include "BTN.h"
#include "LED.h"

#define SLEEP_MS 1

//the device
static const struct device *display_dev = DEVICE_DT_GET(DT_CHOSEN(zephyr_display));

//the canvas
static lv_obj_t *screen = NULL;

int main(void) {

  //check if it's ready
  if (!device_is_ready(display_dev)) {
        return 0;
    }

  //returns pointer to active screan (root container where UI elements are drawn) (canvas)
  screen = lv_screen_active();
  if (screen == NULL) {
      return 0;
  }

  if (0 > BTN_init()) {
    return 0;
  }
  if (0 > LED_init()) {
    return 0;
  }

  //creating the objects
  lv_obj_t *label1 = lv_label_create(screen);

  lv_obj_t *label2 = lv_label_create(screen);

  //content
  // lv_image_set_src(image, &IMG_4439);
  // lv_obj_align(image, LV_ALIGN_CENTER, 0, 0);
 
  lv_label_set_text(label1, "hi");

  lv_label_set_text(label2, "morbin time");
  lv_obj_align(label2, LV_ALIGN_CENTER, 20, 0);


  display_blanking_off(display_dev);
  while (1) {
    //must call periodically to render changes
    lv_timer_handler();
    k_msleep(SLEEP_MS);

    if (BTN_check_clear_pressed(BTN2)){
      lv_label_set_text(label2, "morbin times!!!!");
      lv_obj_align(label2, LV_ALIGN_CENTER, -20, 0);
    }

    if (BTN_check_clear_pressed(BTN0)){
      lv_label_set_text(label2, "morbin time");
      lv_obj_align(label2, LV_ALIGN_CENTER, -20, 0);
    }
    
  }
  return 0;
}
```
